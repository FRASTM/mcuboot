## boot/zephyr/boards/stm32h573i_dk.conf
```kconfig
CONFIG_BOOT_DIRECT_XIP=y
CONFIG_MSPI_XIP=y
CONFIG_BOOT_MAX_IMG_SECTORS_AUTO=n
CONFIG_BOOT_MAX_IMG_SECTORS=4096
#CONFIG_LOG=y
#CONFIG_MSPI_LOG_LEVEL_DBG=y
```
